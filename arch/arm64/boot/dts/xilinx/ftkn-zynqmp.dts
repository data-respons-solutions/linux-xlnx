// SPDX-License-Identifier: GPL-2.0+
/*
 * dts file for Xilinx ZynqMP ZCU106
 *
 * (C) Copyright 2016, Xilinx, Inc.
 *
 * Michal Simek <michal.simek@xilinx.com>
 */

/dts-v1/;

#include "ftkn-zynqmp.dtsi"
#include "ftkn-zynqmp-pl.dtsi"
/ {
	model = "ZynqMP FTKN PL";
	aliases {
		gpio0 = &axi_gpio_0;
	};
};

&axi_gpio_0 {
	status = "okay";
};
