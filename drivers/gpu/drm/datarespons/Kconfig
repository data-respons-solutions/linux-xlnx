## drivers/gpu/drm/datarespons/Kconfig
```kconfig
config DATARESPONS_VIDEO_VDMA
	tristate "Data Respons VDMA Driver"
	help
	  Enable support for Data Respons driver

config DATARESPONS_VIDEO_MIXER
	tristate "Data Respons Video Mixer"
	help
	  Data Respons Video Mixer configuration driver

config DATARESPONS_VIDEO_TPG
	tristate "Data Respons Video Test Pattern Generator"
	help
	  Data Respons Video Test Patterm Generator configuration driver

config DATARESPONS_VIDEO_VPSS
	tristate "Data Respons VPSS driver"
	help
	  Data Respons Video Process SubSystem driver

config DATARESPONS_VIDEO_BT656AT
	tristate "Data Respons BT656 to AXIS transcoder driver"
	help
	  Data Respons BT656 to AXIS transcoder driver

config DATARESPONS_VIDEO_SYNC
	tristate "Data Respons Video Sync driver"
	help
	  Data Respons Video Sync driver

config DATARESPONS_DRM_PANEL_VDMA
	tristate "Data Respons VDMA DRM panel driver"
	help
	  This driver supports Data Respons VDMA panels that are managed
	  by FPGA hardware

config DATARESPONS_DRM
	tristate "Data Respons DRM driver"
	help
	  This driver manages the DRM pipeline
```
